## boards/shields/trackball_peripheral/Kconfig.shield
```kconfig
config SHIELD_TRACKBALL_PERIPHERAL
    def_bool $(shields_list_contains,trackball_peripheral)
```

## config/west.yml
```yaml
manifest:
  remotes:
    - name: zmkfirmware
      url-base: https://github.com/zmkfirmware
    - name: hitsmaxft
      url-base: https://github.com/hitsmaxft
    - name: englmaxi
      url-base: https://github.com/englmaxi
    - name: urob
      url-base: https://github.com/urob
    - name: janpfischer
      url-base: https://github.com/janpfischer
    - name: carrefinho
      url-base: https://github.com/carrefinho
    - name: sekigon-gonnoc
      url-base: https://github.com/sekigon-gonnoc
    - name: cormoran
      url-base: https://github.com/cormoran
  projects:
    # ZMK本体を cormoran のフォークに差し替える（DYA Studio の非公式RPCに必要）
    # main+dya は Zephyr v4.1.0+zmk-fixes ベースなので、今の xiao_ble//zmk 構成のまま使える
    - name: zmk
      remote: cormoran
      revision: main+dya
      clone-depth: 1
      import:
        file: app/west.yml
    - name: zmk-helpers
      remote: urob
      revision: main
      clone-depth: 1
    #- name: zmk-rgbled-widget
    #  remote: hitsmaxft
    #  revision: main
    #  clone-depth: 1
    - name: zmk-dongle-display
      remote: englmaxi
      revision: main
      clone-depth: 1
    #- name: zmk-dongle-screen
    #  remote: janpfischer
    #  revision: main
    #  clone-depth: 1
    - name: prospector-zmk-module
      remote: carrefinho
      revision: feat/new-status-screens
      clone-depth: 1
    - name: zmk-driver-paw3222
      remote: sekigon-gonnoc
      revision: main
      clone-depth: 1

    # ---- DYA Studio 用モジュール ----
    # トラックボールの実行時調整（感度・回転・軸スナップ・マウスレイヤー）
    - name: zmk-module-runtime-input-processor
      remote: cormoran
      revision: main
    # 上記モジュールが設定の永続化に使うバックエンド
    - name: zmk-feature-custom-settings
      remote: cormoran
      revision: main
    # スリープ/アイドルなどのデバイス設定をWebから変更する
    - name: zmk-module-settings-rpc
      remote: cormoran
      revision: main
    # zmk-feature-runtime-combo と zmk-feature-runtime-macro は RAM 不足で
    # 載せられなかった。詳細は cornix_dongle_adapter.conf のコメント参照。
  self:
    path: config
```
