#include "../../jzf/cornix/cornix_dongle_common.dtsi"

/ {
    // Receiving end of the trackball's split input (from the peripheral over BLE)
    split_inputs {
        #address-cells = <1>;
        #size-cells = <0>;

        trackball_split: trackball_split@0 {
            compatible = "zmk,input-split";
            reg = <0>;
        };
    };

    // Route the received trackball movement into the HID mouse
    trackball_listener: trackball_listener {
        compatible = "zmk,input-listener";
        device = <&trackball_split>;
    };
};
//vim: set ft=dts:
